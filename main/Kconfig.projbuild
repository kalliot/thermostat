## main/Kconfig.projbuild
```kconfig
menu "Thermostat Configuration"

    config SETUPLED_GPIO
        int "Setup led gpio"
        range 0 36
        default 12
        help
            This led is lit when config web ap server is active.

    config WLANSTATUS_GPIO
        int "Wlan status led gpio"
        range 0 36
        default 14
        help
            This led is lit when wlan is connected.

    config MQTTSTATUS_GPIO
        int "MQTT status led gpio"
        range 0 36
        default 13
        help
            This led is lit when mqtt is in connected state.

    config HEATER_GPIO
        int "Heating element gpio"
        range 0 36
        default 22
        help
            The solid state relay is controlled by this.

    config SENDING_GPIO
        int "Indicator for mqtt send"
        range 0 36
        default 2
        help
            This led flashes when there is mqtt send going.

    config ESP_WIFI_SSID
        string "WiFi SSID"
        default "myssid"
        help
            SSID (network name) for the example to connect to.

    config ESP_WIFI_PASSWORD
        string "WiFi Password"
        default "mypassword"
        help
            WiFi password (WPA or WPA2) for the example to use.

    config ESP_WIFI_CHANNEL
        int "WiFi Channel"
        range 1 13
        default 1
        help
            WiFi channel (network channel) for the example to use.

    config ESP_MAX_STA_CONN
        int "Maximal STA connections"
        default 1
        help
            Max number of the STA connects to AP.

    config PIN_NUM_MOSI
        int "GPIO number of MOSI"
        default 19 
        help
            7-seg GPIO number of MOSI

    config PIN_NUM_CLK
        int "GPIO number of CLK"
        default 18
        help
            7-seg GPIO number of CLK

    config PIN_NUM_CS
        int "GPIO number of CS"
        default 5
        help
            7-seg GPIO number of CS

    config OTA_RECV_TIMEOUT
        int "OTA Receive Timeout"
        default 5000
        help
            Maximum time for reception

    config FIRMWARE_UPGRADE_URL
        string "Firmware Upgrade url basepath"
        default "https://192.168.101.233:8070/ota"
        help
            Base URL of server which hosts the firmware images.


    config ENABLE_PARTIAL_HTTP_DOWNLOAD
        bool "Enable partial HTTP download"
        default n
        help
            This enables use of Range header in esp_https_ota component.
            Firmware image will be downloaded over multiple HTTP requests.

    config HTTP_REQUEST_SIZE
        int "HTTP request size"
        default MBEDTLS_SSL_IN_CONTENT_LEN
        depends on ENABLE_PARTIAL_HTTP_DOWNLOAD
        help
            This options specifies HTTP request size. Number of bytes specified
            in this option will be downloaded in single HTTP request.

endmenu
```
